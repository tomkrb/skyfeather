## CMakeLists.txt
```
# SPDX-License-Identifier: Apache-2.0

cmake_minimum_required(VERSION 3.20.0)

set(SHIELD adafruit_2900_oled adafruit_4565_9dof_imu adafruit_3632_joy)
# set(SHIELD adafruit_2900_oled adafruit_4565_9dof_imu)


find_package(Zephyr REQUIRED HINTS $ENV{ZEPHYR_BASE})
project(skyfeather)

target_sources(app PRIVATE src/main.c)
```

## prj.conf
```kconfig
CONFIG_DISPLAY=y
CONFIG_SSD1306=y
CONFIG_LOG=y

# from cfb example
CONFIG_STDOUT_CONSOLE=y
CONFIG_HEAP_MEM_POOL_SIZE=16384
CONFIG_DISPLAY=y
CONFIG_LOG=y
CONFIG_CFB_LOG_LEVEL_DBG=y
CONFIG_CHARACTER_FRAMEBUFFER=y

CONFIG_SHELL=y
CONFIG_CHARACTER_FRAMEBUFFER_SHELL=y

CONFIG_CBPRINTF_FP_SUPPORT=y

CONFIG_SENSOR_LOG_LEVEL_DBG=y
```

## src/main.c
```c
/*
 * Copyright (c) 2018 PHYTEC Messtechnik GmbH
 *
 * SPDX-License-Identifier: Apache-2.0
 */

/* Screen */
#include <zephyr/kernel.h>
#include <zephyr/device.h>
#include <zephyr/display/cfb.h>
#include <stdio.h>

/* Buttons */
#include <zephyr/drivers/gpio.h>
#include <zephyr/devicetree.h>
#include <zephyr/devicetree/gpio.h>

/* accelerometer */
#include <zephyr/drivers/sensor.h>


/* joystick */
#include <zephyr/drivers/sensor/seesaw.h>

/*
 * Get button configuration from the devicetree sw0 alias. This is mandatory.
 */
#define BTN_A_NODE	DT_NODELABEL(buttona)
#define BTN_B_NODE	DT_NODELABEL(buttonb)
#define BTN_C_NODE	DT_NODELABEL(buttonc)
#if !DT_NODE_HAS_STATUS(BTN_A_NODE, okay) || !DT_NODE_HAS_STATUS(BTN_B_NODE, okay)  || !DT_NODE_HAS_STATUS(BTN_C_NODE, okay) 
#error "Unsupported board: button_a, b or c devicetree node(s) is/are not defined"
#endif

static const struct gpio_dt_spec buttona = GPIO_DT_SPEC_GET_OR(BTN_A_NODE, gpios, {0});
static const struct gpio_dt_spec buttonb = GPIO_DT_SPEC_GET_OR(BTN_B_NODE, gpios, {0});
static const struct gpio_dt_spec buttonc = GPIO_DT_SPEC_GET_OR(BTN_C_NODE, gpios, {0});

const struct device *const lsm6dso = DEVICE_DT_GET_ONE(st_lsm6dso);

void configure_button(const struct gpio_dt_spec *button)
{
	if (!device_is_ready(button->port)) {
		printk("Button device not ready: %s\n", button->port->name);
		return;
	}

	int ret = gpio_pin_configure_dt(button, GPIO_INPUT);
	if (ret != 0) {
		printk("Error %d: failed to configure %s pin %d\n", ret, button->port->name, button->pin);
	}

	printk("Success.  Configured %s pin %d\n", button->port->name, button->pin);
}

int init_screen(const struct device *display)
{
	uint16_t x_res;
	uint16_t y_res;
	uint16_t rows;
	uint8_t ppt;
	uint8_t font_width;
	uint8_t font_height;

	if (display_set_pixel_format(display, PIXEL_FORMAT_MONO10) != 0) {
		if (display_set_pixel_format(display, PIXEL_FORMAT_MONO01) != 0) {
			printf("Failed to set required pixel format");
			return 0;
		} else {
			printf("display_set...(MONO01)\n");
		}
	} else {
		printf("display_set....(MONO10)\n");
	}

	printf("Initialized %s\n", display->name);

	if (cfb_framebuffer_init(display)) {
		printf("Framebuffer initialization failed!\n");
		return 0;
	}


	cfb_framebuffer_clear(display, true);

	display_blanking_off(display);

	x_res = cfb_get_display_parameter(display, CFB_DISPLAY_WIDTH);
	y_res = cfb_get_display_parameter(display, CFB_DISPLAY_HEIGH);
	rows = cfb_get_display_parameter(display, CFB_DISPLAY_ROWS);
	ppt = cfb_get_display_parameter(display, CFB_DISPLAY_PPT);

	for (int idx = 0; idx < 42; idx++) {
		if (cfb_get_font_size(display, idx, &font_width, &font_height)) {
			break;
		}
		cfb_framebuffer_set_font(display, idx);
		printf("font width %d, font height %d\n",
		       font_width, font_height);
	}
	cfb_framebuffer_set_font(display, 0);


	printf("x_res %d, y_res %d, ppt %d, rows %d, cols %d\n",
	       x_res,
	       y_res,
	       ppt,
	       rows,
	       cfb_get_display_parameter(display, CFB_DISPLAY_COLS));

	// cfb_framebuffer_invert(display);

	// cfb_set_kerning(display, 3);

	return 0;
}

// void joy_feather(void)
// {}

void get_accelerometer(double *x, double *y, double *z)
{
		struct sensor_value accel_xyz[3];
		struct sensor_value gyro_xyz[3];
		struct sensor_value magn_xyz[3];

		if (sensor_sample_fetch(lsm6dso) < 0) {
			printf("LSM6DSO Sensor sample update error\n");
		}
		sensor_channel_get(lsm6dso, SENSOR_CHAN_ACCEL_XYZ, accel_xyz);
		sensor_channel_get(lsm6dso, SENSOR_CHAN_GYRO_XYZ, gyro_xyz);

		printf(
		   "Acc: x: %4.1f, y: %4.1f, z: %4.1f\t",
		   sensor_value_to_double(&accel_xyz[0]),
		   sensor_value_to_double(&accel_xyz[1]),
		   sensor_value_to_double(&accel_xyz[2]));

		printf(
		   "Gyro: x: %4.1f, y: %4.1f, z: %4.1f\t",
		   sensor_value_to_double(&gyro_xyz[0]),
		   sensor_value_to_double(&gyro_xyz[1]),
		   sensor_value_to_double(&gyro_xyz[2]));
		*x = sensor_value_to_double(&accel_xyz[0]);
		*y = sensor_value_to_double(&accel_xyz[1]);
		*z = sensor_value_to_double(&accel_xyz[2]);
}	

int main(void)
{
	const struct device *display;
	const struct device *joy_feather;
	
	char output_str[64];

	configure_button(&buttona);
	configure_button(&buttonb);
	configure_button(&buttonc);

	display = DEVICE_DT_GET(DT_CHOSEN(zephyr_display));

	if (!device_is_ready(display)) {
		printf("Device %s not ready\n", display->name);
		return 0;
	}

	init_screen(display);


	if (!device_is_ready(lsm6dso)) {
		printk("%s: device not ready.\n", lsm6dso->name);
		// return 0;
	}

	joy_feather = DEVICE_DT_GET(DT_NODELABEL(joywing_seesaw));
	if( !device_is_ready(joy_feather)) {
		printk("%s: device not ready.\n", joy_feather->name);
		// return 0;
	}

	printf("Now just loopin'...\n");
	#define USE(pin) do { \
		seesaw_gpio_pin_set_output(joy_feather, pin); \
		seesaw_gpio_pin_set(joy_feather, pin); \
	} while (0)	
	USE(6); // A
	USE(7); // B
	USE(9); // Y
	USE(10); // X
	USE(14); // Sel

	#define PIN(name,pin) printf( "%s", seesaw_gpio_pin_get(joy_feather, pin) ? name : " " )
	while (1) {
		uint32_t buttons = seesaw_gpio_sample_fetch(joy_feather);
		PIN("A", 6);
		PIN("B", 7);
		PIN("Y", 9);
		PIN("X", 10);
		PIN("S", 14);
		printf("\t\t");


		uint16_t val;
		seesaw_adc_channel_read(joy_feather, 0, &val);
		printf(" ADC 0: %04x\t", val);

		seesaw_adc_channel_read(joy_feather, 1, &val);
		printf(" ADC 1: %04x\r", val);
		// k_sleep(K_MSEC(50));

		// cfb_framebuffer_clear(display, true);
		double acc_x, acc_y, acc_z;
		get_accelerometer(&acc_x, &acc_y, &acc_z);
		snprintf(output_str, 63,
		   "%4.1f %4.1f %4.1f        ",
		   acc_x, acc_y, acc_z);

		int vala = gpio_pin_get_dt(&buttona);
		int valb = gpio_pin_get_dt(&buttonb);
		int valc = gpio_pin_get_dt(&buttonc);

		char key_str[64];
		snprintf(key_str, 63,
		   "%c %c %c 	  ",
		   vala ? 'A' : 'a',
		   valb ? 'B' : 'b',
		   valc ? 'C' : 'c');
		   
		// printf("%s                                     \r", key_str);

		if (cfb_print(display, key_str, 0, 0)) {
			printf("Failed to print a string\n");
			continue;
		}
		if (cfb_print(display, output_str, 0, 16)) {
			printf("Failed to print a string\n");
			continue;
		}

		
		// printf("i = %d\n", i);
		cfb_framebuffer_finalize(display);
		k_sleep(K_MSEC(50));
	}

	while (1) {
		double acc_x, acc_y, acc_z;
		get_accelerometer(&acc_x, &acc_y, &acc_z);
		snprintf(output_str, 63,
		   "%4.1f %4.1f %4.1f        ",
		   acc_x, acc_y, acc_z);

		int vala = gpio_pin_get_dt(&buttona);
		int valb = gpio_pin_get_dt(&buttonb);
		int valc = gpio_pin_get_dt(&buttonc);

		printf("read keys: %d %d %d\n", vala, valb, valc);

		char key_str[64];
		snprintf(key_str, 63,
		   "%c %c %c 	  ",
		   vala ? 'A' : 'a',
		   valb ? 'B' : 'b',
		   valc ? 'C' : 'c');
		   
		// cfb_framebuffer_clear(display, true);
		if (cfb_print(display, key_str, 0, 0)) {
			printf("Failed to print a string\n");
			continue;
		}
		if (cfb_print(display, output_str, 0, 16)) {
			printf("Failed to print a string\n");
			continue;
		}
		
		// printf("i = %d\n", i);
		cfb_framebuffer_finalize(display);
		k_sleep(K_MSEC(50));
	}
	return 0;
}
```
